## tests/driver/gpio/testcase.yaml
```yaml
tests:
  peripheral.gpio:
    depends_on: gpio
    tags: drivers userspace
    platform_exclude: nsim
```

## tests/driver/uart/testcase.yaml
```yaml
tests:
  peripheral.uart:
    depends_on: uart
    tags: drivers userspace
    platform_exclude: emsk emsdp nsim
```
